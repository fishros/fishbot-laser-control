/**
 * @author fishros (fishros@foxmail.com)
 * @brief  待补充
 * @version V1.0.0.220919
 * @date 2022-0919
 *
 * 版权所有：FishBot Open Source Organization
 *
 */
#include "esp_log.h"
#include "esp_system.h"
#include "esp_err.h"
#include "oled.h"

#include <stdio.h>
#include <string.h>
#include <stdlib.h>

#include "freertos/FreeRTOS.h"
#include "freertos/task.h"
#include "freertos/queue.h"
#include "freertos/event_groups.h"

#include "driver/i2c.h"

#define I2C_MASTER_SCL_IO 12                /*!< gpio number for I2C master clock */
#define I2C_MASTER_SDA_IO 14                /*!< gpio number for I2C master data  */
#define I2C_MASTER_NUM I2C_NUM_0            /*!< I2C port number for master dev */
#define I2C_EXAMPLE_MASTER_TX_BUF_DISABLE 0 /*!< I2C master do not need buffer */
#define I2C_EXAMPLE_MASTER_RX_BUF_DISABLE 0 /*!< I2C master do not need buffer */

#define OLED_ADDR 0x3C             /*!< slave address for MPU6050 sensor */
#define WRITE_BIT I2C_MASTER_WRITE /*!< I2C master write */
#define READ_BIT I2C_MASTER_READ   /*!< I2C master read */
#define ACK_CHECK_EN 0x1           /*!< I2C master will check ack from slave*/
#define ACK_CHECK_DIS 0x0          /*!< I2C master will not check ack from slave */
#define ACK_VAL 0x0                /*!< I2C ack value */
#define NACK_VAL 0x1               /*!< I2C nack value */
#define LAST_NACK_VAL 0x2          /*!< I2C last_nack value */

/*
  (0) !(1) "(2) #(3) $(4) %(5) &(6) '(7) ((8) )(9) *(10) +(11) ,(12) -(13) .(14) /(15)
 0(16) 1(17) 2(18) 3(19) 4(20) 5(21) 6(22) 7(23) 8(24) 9(25) :(26) ;(27) <(28) =(29) >(30) ?(31)
 @(32) A(33) B(34) C(35) D(36) E(37) F(38) G(39) H(40) I(41) J(42) K(43) L(44) M(45) N(46) O(47)
 P(48) Q(49) R(50) S(51) T(52) U(53) V(54) W(55) X(56) Y(57) Z(58) [(59) \(60) ](61) ^(62) _(63)
 `(64) a(65) b(66) c(67) d(68) e(69) f(70) g(71) h(72) i(73) j(74) k(75) l(76) m(77) n(78) o(79)
 p(80) q(81) r(82) s(83) t(84) u(85) v(86) w(87) x(88) y(89) z(90) {(91) |(92) }(93) ~(94)

 */
uint8_t ascii[95][6] = {
    {0x00, 0x00, 0x00, 0x00, 0x00, 0x00}, // sp
    {0x00, 0x00, 0x00, 0x2f, 0x00, 0x00}, // !
    {0x00, 0x00, 0x07, 0x00, 0x07, 0x00}, // "
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    {0x14, 0x14, 0x14, 0x14, 0x14, 0x14}, // horiz lines
};

/**
 * i2c init
 */
static void i2c_master_init()
{
    int i2c_master_port = I2C_MASTER_NUM;
    i2c_config_t conf;
    conf.mode = I2C_MODE_MASTER;
    conf.sda_io_num = I2C_MASTER_SDA_IO;
    conf.sda_pullup_en = 0;
    conf.scl_io_num = I2C_MASTER_SCL_IO;
    conf.scl_pullup_en = 0;
    ESP_ERROR_CHECK(i2c_driver_install(i2c_master_port, conf.mode));
    ESP_ERROR_CHECK(i2c_param_config(i2c_master_port, &conf));
}

void oled_clear()
{
    for (int x = 0; x < 8; x++)
    {
        oled_write(0x00, 0xb0 + x);
        oled_write(0x00, 0x00);
        oled_write(0x00, 0x10);
        for (int y = 0; y < 128; y++)
            oled_write(0x40, 0x00);
    }
}

//初始化oled
void oled_init()
{
    uint8_t y = 0, i;
    uint8_t cmd_data[] = {0xae, 0x20, 0x10, 0xb0, 0xc8, 0x00,
                          0x10, 0x40, 0x81, 0x7f, 0xa1, 0xa6,
                          0xa8, 0x3f, 0xa4, 0xd3, 0x00, 0xd5,
                          0xf0, 0xd9, 0x22, 0xda, 0x12, 0xdb,
                          0x20, 0x8d, 0x14, 0xaf};
    i2c_master_init();
    oled_writes(0x00, cmd_data, 28);
    vTaskDelay(200 / portTICK_RATE_MS);

    oled_clear();
    oled_ascii(0, 0, "   FishTcp2Server   ");
    oled_ascii(0, 1, " www.fishros.org.cn ");
}

void oled_ascii(uint8_t x, uint8_t y, char *str)
{
    oled_setxy(x, y);
    for (int i = 0; i < 22 && (str[i] != 0); i++)
    {
        for (int j = 0; j < 6; j++)
        {
            oled_write(0x40, ascii[str[i] - 32][j]);
        }
    }
    // oled_setxy(x, y + 1);
    // for (int i = 0; i < 16 && (str[i] != 0); i++)
    // {
    //     for (int j = 8; j < 16; j++)
    //     {
    //         oled_write(0x40, ascii[str[i] - 32][j]);
    //     }
    // }
}

void oled_write(uint8_t reg_address, uint8_t data)
{
    i2c_cmd_handle_t cmd = i2c_cmd_link_create();
    i2c_master_start(cmd);
    i2c_master_write_byte(cmd, OLED_ADDR << 1 | WRITE_BIT, ACK_CHECK_EN);
    i2c_master_write_byte(cmd, reg_address, ACK_CHECK_EN);
    i2c_master_write_byte(cmd, data, ACK_CHECK_EN);
    i2c_master_stop(cmd);
    i2c_master_cmd_begin(I2C_MASTER_NUM, cmd, 1000 / portTICK_RATE_MS);
    i2c_cmd_link_delete(cmd);
}

void oled_writes(uint8_t reg_address, uint8_t *data, uint8_t data_len)
{
    i2c_cmd_handle_t cmd = i2c_cmd_link_create();
    i2c_master_start(cmd);
    i2c_master_write_byte(cmd, OLED_ADDR << 1 | WRITE_BIT, ACK_CHECK_EN);
    i2c_master_write_byte(cmd, reg_address, ACK_CHECK_EN);
    i2c_master_write(cmd, data, data_len, ACK_CHECK_EN);
    i2c_master_stop(cmd);

    i2c_master_cmd_begin(I2C_MASTER_NUM, cmd, 1000 / portTICK_RATE_MS);
    i2c_cmd_link_delete(cmd);
}

void oled_setxy(uint8_t x, uint8_t y)
{
    oled_write(0x00, 0xb0 + y);
    oled_write(0x00, (x & 0x0f));
    oled_write(0x00, ((x & 0xf0) >> 4) | 0x10);
}

void oled_delete(void)
{
    i2c_driver_delete(I2C_NUM_0);
}